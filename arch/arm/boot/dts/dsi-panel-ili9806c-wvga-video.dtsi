/* Copyright (c) 2013, The Linux Foundation. All rights reserved.
 *
 * This program is free software; you can redistribute it and/or modify
 * it under the terms of the GNU General Public License version 2 and
 * only version 2 as published by the Free Software Foundation.
 *
 * This program is distributed in the hope that it will be useful,
 * but WITHOUT ANY WARRANTY; without even the implied warranty of
 * MERCHANTABILITY or FITNESS FOR A PARTICULAR PURPOSE.  See the
 * GNU General Public License for more details.
 */

/*---------------------------------------------------------------------------
 * This file is autogenerated file using gcdb parser. Please do not edit it.
 * Update input XML file to add a new entry or update variable in this file
 * VERSION = "1.0"
 *---------------------------------------------------------------------------*/
&mdss_mdp {
	dsi_ili9806c_wvga_vid: qcom,mdss_dsi_ili9806c_wvga_video {
		qcom,mdss-dsi-panel-name = "ILI9806C wvga video mode dsi panel";
		zte,lcd-proc-panel-name = "zte(ILI9806C)_wvga_4.0Inch";
		qcom,mdss-dsi-panel-controller = <&mdss_dsi0>;
		qcom,mdss-dsi-panel-type = "dsi_video_mode";
		qcom,mdss-dsi-panel-destination = "display_1";
		qcom,mdss-dsi-panel-framerate = <60>;
		qcom,mdss-dsi-virtual-channel-id = <0>;
		qcom,mdss-dsi-stream = "rgb_swap_rgb";
		qcom,mdss-dsi-panel-width = <480>;
		qcom,mdss-dsi-panel-height = <800>;
		qcom,mdss-pan-physical-width-dimension = <52>;
		qcom,mdss-pan-physical-height-dimension = <87>;
		qcom,mdss-dsi-h-front-porch = <90>;
		qcom,mdss-dsi-h-back-porch = <90>;
		qcom,mdss-dsi-h-pulse-width = <10>;
		qcom,mdss-dsi-h-sync-skew = <0>;
		qcom,mdss-dsi-v-back-porch = <10>;
		qcom,mdss-dsi-v-front-porch = <50>;
		qcom,mdss-dsi-v-pulse-width = <10>;
		qcom,mdss-dsi-h-left-border = <0>;
		qcom,mdss-dsi-h-right-border = <0>;
		qcom,mdss-dsi-v-top-border = <0>;
		qcom,mdss-dsi-v-bottom-border = <0>;
		qcom,mdss-dsi-bpp = <24>;
		qcom,mdss-dsi-underflow-color = <0xff>;
		qcom,mdss-dsi-border-color = <0>;
		qcom,mdss-dsi-on-command = [
                  39  01  00  00  00 00 04  
                        FF  FF 98 16
                  39  01  00  00  00 00 02
                        BA  60
                  39  01  00  00  00 00 02  
                        B0  01
                  39  01  00  00  00 00 18  
                        BC  03  0D  61  
                        FF  01  01  1B  
                        0F  3A  63  FF  
                        FF  01  01  02  
                        00  D5  D0  01  
                        00  00  43  0B
                  39  01  00  00  00 00 09  
                        BD  01  23  45  
                        67  01  23  45  
                        67
                  39  01  00  00  00 00 12  
                        BE  13  22  DD  
                        CC  BB  AA  22  
                        26  72  FF  22  
                        EE  22  22  22  
                        22  22
                  39  01  00  00  00 00 03  
                        ED  7F  0F
                  39  01  00  00  00 00 02  
                        F3  70
                  39  01  00  00  00 00 02  
                        B4  02
                  39  01  00  00  00 00 04  
                        C0  0F  0B  08
                  39  01  00  00  00 00 05  
                        C1  17  90  78  20
                  39  01  00  00  00 00 02  
                        D8  50
                  39  01  00  00  00 00 02  
                        FC  08
                  39  01  00  00  00 00 11  
                        E0  00  05  0F  
                        12  14  1D  CD  
                        09  05  0B  01  
                        10  0E  35  30  
                        00
                  39  01  00  00  00 00 11  
                        E1  00  02  0C  
                        0F  12  19  76  
                        08  01  06  07  
                        0A  09  27  23  
                        00
                  39  01  00  00  00 00 09  
                        D5  06  0A  0C  
                        0C  CB  A5  01  
                        04
                  39  01  00  00  00 00 02  
                        F7  8A
                  39  01  00  00  00 00 02  
                        C7  7A
                  39  01  00  00  00 00 05  
                        F9  04  FF  80  
                        90
                  05  01  00  00  78 00 02  
                        11 00
                  05  01  00  00  0a 00 02  
                        29 00];
		qcom,mdss-dsi-off-command = [05 01 00 00 32 00 02 28 00
					05 01 00 00 78 00 02 10 00];
		qcom,mdss-dsi-on-command-state = "dsi_lp_mode";
		qcom,mdss-dsi-off-command-state = "dsi_lp_mode";
		qcom,mdss-dsi-h-sync-pulse = <1>;
		qcom,mdss-dsi-traffic-mode = "non_burst_sync_plus";
		qcom,mdss-dsi-lane-map = "lane_map_3012";
		qcom,mdss-dsi-bllp-eof-power-mode;
		qcom,mdss-dsi-bllp-power-mode;
		qcom,mdss-dsi-lane-0-state;
		qcom,mdss-dsi-lane-1-state;
		qcom,mdss-dsi-panel-timings = [80 1D 13  00 42 46 18 20 20 03 04 00]; // 419.69MHZ   frame=60hz
		qcom,mdss-dsi-t-clk-post = <0x04>;
		qcom,mdss-dsi-t-clk-pre = <0x1b>;
		qcom,mdss-dsi-bl-min-level = <1>;
		qcom,mdss-dsi-bl-max-level = <255>;
		qcom,mdss-dsi-dma-trigger = "trigger_sw";
		qcom,mdss-dsi-mdp-trigger = "none";
		qcom,mdss-dsi-bl-pmic-control-type = "bl_ctrl_wled";
                qcom,mdss-dsi-reset-sequence = <1 20>, <0 2>, <1 20>;
	};
};
