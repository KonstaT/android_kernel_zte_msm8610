/* Copyright (c) 2013, The Linux Foundation. All rights reserved.
 *
 * This program is free software; you can redistribute it and/or modify
 * it under the terms of the GNU General Public License version 2 and
 * only version 2 as published by the Free Software Foundation.
 *
 * This program is distributed in the hope that it will be useful,
 * but WITHOUT ANY WARRANTY; without even the implied warranty of
 * MERCHANTABILITY or FITNESS FOR A PARTICULAR PURPOSE.  See the
 * GNU General Public License for more details.
 */

qcom,zte-4v2-1150mah-data {
	qcom,fcc-mah = <1150>;
	qcom,default-rbatt-mohm = <213>;
	qcom,rbatt-capacitive-mohm = <0>;
	qcom,flat-ocv-threshold-uv = <3800000>;
	qcom,max-voltage-uv = <4200000>;
	qcom,v-cutoff-uv = <3400000>;
	qcom,chg-term-ua = <100000>;
	qcom,batt-id-kohm = <120>;

	qcom,rbatt-sf-lut {
		qcom,lut-col-legend = <(-20) 0 25 40 60>;
		qcom,lut-row-legend = <100 95 90 85 80>,
				<75 70 65 60 55>,
				<50 45 40 35 30>,
				<25 20 16 13 11>,
				<10 9 8 7 6>,
				<5 4 3 2 1>,
                <0>;
		qcom,lut-data = <456 184 100 83 77>,
				<457 184 100 84 77>,
				<460 192 104 86 78>,
				<459 197 108 89 81>,
				<459 202 113 92 83>,
				<456 203 119 96 85>,
				<457 200 125 100 88>,
				<461 188 126 106 92>,
				<468 184 115 106 96>,
				<478 183 103 92 84>,
				<493 184 100 86 80>,
				<511 190 100 87 82>,
				<530 198 103 89 84>,
				<551 210 109 92 88>,
				<604 223 115 95 87>,
				<653 238 118 95 84>,
				<700 247 116 93 84>,
				<746 248 115 93 83>,
				<808 230 112 94 84>,
				<795 225 110 96 86>,
				<883 230 111 96 87>,
				<1048 236 113 96 88>,
				<1262 245 115 97 88>,
				<1560 254 117 97 89>,
				<1988 264 118 97 89>,
				<2613 277 118 96 88>,
				<3575 302 120 98 92>,
				<4938 345 130 103 98>,
				<6764 421 152 113 107>,
				<12502 1475 3623 241 222>,
				<87329 45022 99741 18780 40965>;
	};

	qcom,fcc-temp-lut {
		qcom,lut-col-legend = <(-20) 0 25 40 60>;
		qcom,lut-data = <1164 1178 1179 1183 1171>;
	};

	qcom,pc-temp-ocv-lut {
		qcom,lut-col-legend = <(-20) 0 25 40 60>;
		qcom,lut-row-legend = <100 95 90 85 80>,
				<75 70 65 60 55>,
				<50 45 40 35 30>,
				<25 20 16 13 11>,
				<10 9 8 7 6>,
				<5 4 3 2 1>,
                <0>;
		qcom,lut-data = <4159 4160 4154 4158 4146>,
				<4095 4101 4099 4101 4093>,
				<4045 4055 4053 4054 4047>,
				<3991 4009 4011 4012 4006>,
				<3949 3971 3974 3974 3969>,
				<3912 3934 3941 3940 3935>,
				<3879 3898 3910 3909 3905>,
				<3850 3860 3881 3881 3878>,
				<3824 3832 3845 3851 3850>,
				<3803 3809 3813 3815 3814>,
				<3787 3793 3794 3792 3791>,
				<3774 3782 3780 3778 3777>,
				<3764 3774 3772 3768 3767>,
				<3754 3768 3765 3761 3758>,
				<3743 3760 3759 3752 3745>,
				<3724 3743 3745 3735 3722>,
				<3689 3709 3715 3706 3695>,
				<3648 3670 3677 3668 3661>,
				<3619 3636 3657 3645 3643>,
				<3602 3615 3645 3634 3635>,
				<3592 3605 3636 3625 3629>,
				<3581 3595 3627 3614 3620>,
				<3568 3584 3615 3600 3608>,
				<3552 3569 3600 3582 3591>,
				<3529 3543 3574 3554 3563>,
				<3497 3503 3533 3512 3521>,
				<3454 3451 3478 3458 3467>,
				<3399 3386 3409 3392 3404>,
				<3324 3303 3322 3310 3322>,
				<3214 3194 3203 3196 3204>,
				<3000 3000 3000 3000 3000>;
	};
};
