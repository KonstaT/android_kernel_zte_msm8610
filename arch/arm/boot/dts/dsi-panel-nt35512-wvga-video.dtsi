/* Copyright (c) 2013, The Linux Foundation. All rights reserved.
 *
 * This program is free software; you can redistribute it and/or modify
 * it under the terms of the GNU General Public License version 2 and
 * only version 2 as published by the Free Software Foundation.
 *
 * This program is distributed in the hope that it will be useful,
 * but WITHOUT ANY WARRANTY; without even the implied warranty of
 * MERCHANTABILITY or FITNESS FOR A PARTICULAR PURPOSE.  See the
 * GNU General Public License for more details.
 */

/*---------------------------------------------------------------------------
 * This file is autogenerated file using gcdb parser. Please do not edit it.
 * Update input XML file to add a new entry or update variable in this file
 * VERSION = "1.0"
 *---------------------------------------------------------------------------*/
&mdss_mdp {
	dsi_nt35512_wvga_video: qcom,mdss_dsi_nt35512_wvga_video {
		qcom,mdss-dsi-panel-name = "nt35512 wvga video mode dsi panel";
		zte,lcd-proc-panel-name = "zte(nt35512)_wvga_4.0Inch";
		qcom,mdss-dsi-panel-controller = <&mdss_dsi0>;
		qcom,cont-splash-enabled;
		qcom,mdss-dsi-panel-type = "dsi_video_mode";
		qcom,mdss-dsi-panel-destination = "display_1";
		qcom,mdss-dsi-panel-framerate = <60>;
		qcom,mdss-dsi-virtual-channel-id = <0>;
		qcom,mdss-dsi-stream = "rgb_swap_rgb";
		qcom,mdss-dsi-panel-width = <480>;
		qcom,mdss-dsi-panel-height = <800>;
		qcom,mdss-pan-physical-width-dimension = <52>;
		qcom,mdss-pan-physical-height-dimension = <87>;
		qcom,mdss-dsi-h-front-porch = <90>;
		qcom,mdss-dsi-h-back-porch = <90>;
		qcom,mdss-dsi-h-pulse-width = <10>;
		qcom,mdss-dsi-h-sync-skew = <0>;
		qcom,mdss-dsi-v-back-porch = <10>;
		qcom,mdss-dsi-v-front-porch = <50>;
		qcom,mdss-dsi-v-pulse-width = <10>;
		qcom,mdss-dsi-h-left-border = <0>;
		qcom,mdss-dsi-h-right-border = <0>;
		qcom,mdss-dsi-v-top-border = <0>;
		qcom,mdss-dsi-v-bottom-border = <0>;
		qcom,mdss-dsi-bpp = <24>;
		qcom,mdss-dsi-underflow-color = <0xff>;
		qcom,mdss-dsi-border-color = <0>;
		qcom,mdss-dsi-on-command = [29 01 00 00 00 00 06 F0 55 AA 52 08 01
      29 01 00 00 00 00 04 B0 0D 0D 0D
      29 01 00 00 00 00 04 B6 34 34 34
      29 01 00 00 00 00 04 B1 0D 0D 0D
      29 01 00 00 00 00 04 B7 34 34 34
      29 01 00 00 00 00 04 B2 00 00 00
      29 01 00 00 00 00 04 B8 24 24 24
      13 01 00 00 00 00 02 BF 01
      29 01 00 00 00 00 04 B3 0F 0F 0F
      29 01 00 00 00 00 04 B9 34 34 34
      29 01 00 00 00 00 04 B5 08 08 08
      13 01 00 00 00 00 02 C2 03
      29 01 00 00 00 00 04 BA 24 24 24
      29 01 00 00 00 00 04 BC 00 78 00
      29 01 00 00 00 00 04 BD 00 78 00
      29 01 00 00 00 00 03 BE 00 69
      29 01 00 00 00 00 35 D1 00 06 00 07 00 0E 00 22 00 3B 00 71 00 9F 00 E2 01 12 01 57 01 88 01 CE 02 07 02 08 02 39 02 6C 02 87 02 A6 02 BA 02 D2 02 E2 02 F7 03 06 03 1E 03 55 03 FF
      29 01 00 00 00 00 35 D2 00 06 00 07 00 0E 00 22 00 3B 00 71 00 9F 00 E2 01 12 01 57 01 88 01 CE 02 07 02 08 02 39 02 6C 02 87 02 A6 02 BA 02 D2 02 E2 02 F7 03 06 03 1E 03 55 03 FF
      29 01 00 00 00 00 35 D3 00 06 00 07 00 0E 00 22 00 3B 00 71 00 9F 00 E2 01 12 01 57 01 88 01 CE 02 07 02 08 02 39 02 6C 02 87 02 A6 02 BA 02 D2 02 E2 02 F7 03 06 03 1E 03 55 03 FF
      29 01 00 00 00 00 35 D4 00 06 00 07 00 0E 00 22 00 3B 00 71 00 9F 00 E2 01 12 01 57 01 88 01 CE 02 07 02 08 02 39 02 6C 02 87 02 A6 02 BA 02 D2 02 E2 02 F7 03 06 03 1E 03 55 03 FF
      29 01 00 00 00 00 35 D5 00 06 00 07 00 0E 00 22 00 3B 00 71 00 9F 00 E2 01 12 01 57 01 88 01 CE 02 07 02 08 02 39 02 6C 02 87 02 A6 02 BA 02 D2 02 E2 02 F7 03 06 03 1E 03 55 03 FF
      29 01 00 00 00 00 35 D6 00 06 00 07 00 0E 00 22 00 3B 00 71 00 9F 00 E2 01 12 01 57 01 88 01 CE 02 07 02 08 02 39 02 6C 02 87 02 A6 02 BA 02 D2 02 E2 02 F7 03 06 03 1E 03 55 03 FF
      29 01 00 00 00 00 06 F0 55 AA 52 08 00
      29 01 00 00 00 00 01 B1
      13 01 00 00 00 00 02 B6 05
      29 01 00 00 00 00 03 B7 70 70
      29 01 00 00 00 00 05 B8 01 03 03 03
      29 01 00 00 00 00 04 BC 02 00 00
      29 01 00 00 00 00 06 C9 D0 02 50 50 50
      13 01 00 00 00 00 02 35 00
      05 01 00 00 78 00 02 11 00
      05 01 00 00 0a 00 02 29 00];
		qcom,mdss-dsi-off-command = [05 01 00 00 32 00 02 28 00
					05 01 00 00 78 00 02 10 00];
		qcom,mdss-dsi-on-command-state = "dsi_lp_mode";
		qcom,mdss-dsi-off-command-state = "dsi_lp_mode";
		qcom,mdss-dsi-h-sync-pulse = <1>;
		qcom,mdss-dsi-traffic-mode = "non_burst_sync_plus";
		qcom,mdss-dsi-lane-map = "lane_map_3012";
		qcom,mdss-dsi-bllp-eof-power-mode;
		qcom,mdss-dsi-bllp-power-mode;
		qcom,mdss-dsi-lane-0-state;
		qcom,mdss-dsi-lane-1-state;
		qcom,mdss-dsi-panel-timings = [80 1D 13  00 42 46 18 20 20 03 04 00]; // 419.69MHZ   frame=60hz
		qcom,mdss-dsi-t-clk-post = <0x04>;
		qcom,mdss-dsi-t-clk-pre = <0x1b>;
		qcom,mdss-dsi-bl-min-level = <1>;
		qcom,mdss-dsi-bl-max-level = <255>;
		qcom,mdss-dsi-dma-trigger = "trigger_sw";
		qcom,mdss-dsi-mdp-trigger = "none";
		qcom,mdss-dsi-bl-pmic-control-type = "bl_ctrl_wled";
		qcom,mdss-dsi-reset-sequence = <1 20>, <0 2>, <1 20>;
	};
};
