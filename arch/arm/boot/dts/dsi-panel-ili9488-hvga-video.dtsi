/* Copyright (c) 2013, The Linux Foundation. All rights reserved.
 *
 * This program is free software; you can redistribute it and/or modify
 * it under the terms of the GNU General Public License version 2 and
 * only version 2 as published by the Free Software Foundation.
 *
 * This program is distributed in the hope that it will be useful,
 * but WITHOUT ANY WARRANTY; without even the implied warranty of
 * MERCHANTABILITY or FITNESS FOR A PARTICULAR PURPOSE.  See the
 * GNU General Public License for more details.
 */

/*---------------------------------------------------------------------------
 * This file is autogenerated file using gcdb parser. Please do not edit it.
 * Update input XML file to add a new entry or update variable in this file
 * VERSION = "1.0"
 *---------------------------------------------------------------------------*/
&mdss_mdp {
	dsi_ili9488_hvga_vid: qcom,mdss_dsi_ili9488_hvga_video {
		qcom,mdss-dsi-panel-name = "ILI9488 hvga video mode dsi panel";
		zte,lcd-proc-panel-name = "zte(ILI9488)_hvga_3.5Inch";
		qcom,mdss-dsi-panel-controller = <&mdss_dsi0>;
		qcom,cont-splash-enabled = <1>;
		qcom,mdss-dsi-panel-type = "dsi_video_mode";
		qcom,mdss-dsi-panel-destination = "display_1";
		qcom,mdss-dsi-panel-framerate = <60>;
		qcom,mdss-dsi-virtual-channel-id = <0>;
		qcom,mdss-dsi-stream = "rgb_swap_rgb";
		qcom,mdss-pan-physical-width-dimension = <49>;
		qcom,mdss-pan-physical-height-dimension = <74>;        
		qcom,mdss-dsi-panel-width = <320>;
		qcom,mdss-dsi-panel-height = <480>;
		qcom,mdss-dsi-h-front-porch = <90>;
		qcom,mdss-dsi-h-back-porch = <90>;
		qcom,mdss-dsi-h-pulse-width = <10>;
		qcom,mdss-dsi-h-sync-skew = <0>;
		qcom,mdss-dsi-v-back-porch = <10>;
		qcom,mdss-dsi-v-front-porch = <50>;
		qcom,mdss-dsi-v-pulse-width = <10>;
		qcom,mdss-dsi-h-left-border = <0>;
		qcom,mdss-dsi-h-right-border = <0>;
		qcom,mdss-dsi-v-top-border = <0>;
		qcom,mdss-dsi-v-bottom-border = <0>;
		qcom,mdss-dsi-bpp = <24>;
		qcom,mdss-dsi-color-order = <0>;
		qcom,mdss-dsi-underflow-color = <0xff>;
		qcom,mdss-dsi-border-color = <0>;
		qcom,mdss-dsi-on-command = [
		          39  01  00  00  00  00   10  
                         E0 00 03 08
						 08 17 0A 3F
						 78 4C 08 0B
						 08 1C 1E 0F
                  39  01  00  00  00  00   10
                         E1 00 1B 20
                         01 0E 04 35
                         34 48 04 0D
                         0C 35 38 0F
                  39  01  00  00  00  00   03  
                         C0 15 15
                  39  01  00  00  00  00   02  
                         C1 41
                  39  01  00  00  00  00   04  
                         C5 00 24 80
                  39  01  00  00  00  00   02  
                         36 08
                  39  01  00  00  00  00   02  
                         3A 66
                  39  01  00  00  00  00   02  
                         B1 A0
                  39  01  00  00  00  00   02  
                         B4 02
                  39  01  00  00  00  00   03 
                         B6 02 22
                  39  01  00  00  00  00   02  
                         E9 00
                  39  01  00  00  00  00   05  
                         F7 A9 51 2C 82
                  05  01  00  00  78  00  02  
                        11 00
                  05  01  00  00  0a  00  02  
                        29 00];
		qcom,mdss-dsi-off-command = [05 01 00 00 32 00 02 28 00
					05 01 00 00 78 00 02 10 00];
		qcom,mdss-dsi-on-command-state = "dsi_lp_mode";
		qcom,mdss-dsi-off-command-state = "dsi_lp_mode";
		qcom,mdss-dsi-h-sync-pulse = <1>;
		qcom,mdss-dsi-traffic-mode = "burst_mode";
		qcom,mdss-dsi-lane-map = "lane_map_3012";
		qcom,mdss-dsi-bllp-eof-power-mode;
		qcom,mdss-dsi-bllp-power-mode;
		qcom,mdss-dsi-lane-0-state;
		qcom,mdss-dsi-panel-timings = [78 1B 11  00 3E 42 16 1E 1E 03 04 00]; // 257MHZ   frame=60hz
		qcom,mdss-dsi-t-clk-post = <0x04>;
		qcom,mdss-dsi-t-clk-pre = <0x1b>;
		qcom,mdss-dsi-bl-min-level = <1>;
		qcom,mdss-dsi-bl-max-level = <16>;
		qcom,mdss-dsi-dma-trigger = "trigger_sw";
		qcom,mdss-dsi-mdp-trigger = "none";
		qcom,mdss-dsi-bl-pmic-control-type = "bl_ctrl_gpio";
		qcom,mdss-dsi-reset-sequence = <1 20>, <0 2>, <1 20>;//lijiangshuo add 20131128
	};
};
