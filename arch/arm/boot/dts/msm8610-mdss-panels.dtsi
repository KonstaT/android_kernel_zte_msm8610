/* Copyright (c) 2013, The Linux Foundation. All rights reserved.
 *
 * This program is free software; you can redistribute it and/or modify
 * it under the terms of the GNU General Public License version 2 and
 * only version 2 as published by the Free Software Foundation.
 *
 * This program is distributed in the hope that it will be useful,
 * but WITHOUT ANY WARRANTY; without even the implied warranty of
 * MERCHANTABILITY or FITNESS FOR A PARTICULAR PURPOSE.  See the
 * GNU General Public License for more details.
 */

/include/ "dsi-panel-ili9805c-wvga-video.dtsi"
/include/ "dsi-panel-ili9806c-wvga-video.dtsi"
/include/ "dsi-panel-otm8018b-fwvga-video.dtsi" // lijiangshuo add for lead otm8018b for P821B10 20131226
/include/ "dsi-panel-nt35512-wvga-video.dtsi"  /**  ZTE_MODIFY  zhoufan add for nt35512 ZGD LCD 2014-2-10 */
/include/ "dsi-panel-hx8379c_apex_wvga_video.dtsi"  /**  ZTE_MODIFY  wangzhe add for hx8379c ZGD LCD 2014-6-27 */
/include/ "dsi-panel-ili9806e_apex_wvga_video.dtsi"  /**  ZTE_MODIFY  wangzhe add for ili9806e ZGD LCD 2014-8-29 */