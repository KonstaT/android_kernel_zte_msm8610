/* Copyright (c) 2013, The Linux Foundation. All rights reserved.
 *
 * This program is free software; you can redistribute it and/or modify
 * it under the terms of the GNU General Public License version 2 and
 * only version 2 as published by the Free Software Foundation.
 *
 * This program is distributed in the hope that it will be useful,
 * but WITHOUT ANY WARRANTY; without even the implied warranty of
 * MERCHANTABILITY or FITNESS FOR A PARTICULAR PURPOSE.  See the
 * GNU General Public License for more details.
 */

/*---------------------------------------------------------------------------
 * This file is autogenerated file using gcdb parser. Please do not edit it.
 * Update input XML file to add a new entry or update variable in this file
 * VERSION = "1.0"
 *---------------------------------------------------------------------------*/
&mdss_mdp {
	dsi_ili9805c_wvga_vid: qcom,mdss_dsi_ili9805c_wvga_video {
		qcom,mdss-dsi-panel-name = "ILI9805C wvga video mode dsi panel";
		zte,lcd-proc-panel-name = "zte(ILI9805C)_wvga_4.0Inch";
		qcom,mdss-dsi-panel-controller = <&mdss_dsi0>;
		qcom,cont-splash-enabled;
		qcom,mdss-dsi-panel-type = "dsi_video_mode";
		qcom,mdss-dsi-panel-destination = "display_1";
		qcom,mdss-dsi-panel-framerate = <60>;
		qcom,mdss-dsi-virtual-channel-id = <0>;
		qcom,mdss-dsi-stream = "rgb_swap_rgb";
		qcom,mdss-dsi-panel-width = <480>;
		qcom,mdss-dsi-panel-height = <800>;
		qcom,mdss-pan-physical-width-dimension = <52>;
		qcom,mdss-pan-physical-height-dimension = <87>;
		qcom,mdss-dsi-h-front-porch = <90>;
		qcom,mdss-dsi-h-back-porch = <90>;
		qcom,mdss-dsi-h-pulse-width = <10>;
		qcom,mdss-dsi-h-sync-skew = <0>;
		qcom,mdss-dsi-v-back-porch = <10>;
		qcom,mdss-dsi-v-front-porch = <50>;
		qcom,mdss-dsi-v-pulse-width = <10>;
		qcom,mdss-dsi-h-left-border = <0>;
		qcom,mdss-dsi-h-right-border = <0>;
		qcom,mdss-dsi-v-top-border = <0>;
		qcom,mdss-dsi-v-bottom-border = <0>;
		qcom,mdss-dsi-bpp = <24>;
		qcom,mdss-dsi-underflow-color = <0xff>;
		qcom,mdss-dsi-border-color = <0>;
		qcom,mdss-dsi-on-command = [
   39  01  00  00  00 00 04  FF FF 98 05
   39  01  00  00  00 00 05  FD 0F 10 44 33
   39  01  00  00  00 00 09  F8 10 02 02 B4 03 03 11 03
   39  01  00  00  00 00 06  F1 C1 08 00 2B 01
   39  01  00  00  00 00 11  E0 00 07 13 13 12 10 09 06 03 07 0A 0B 0C 28 2A 00
   39  01  00  00  00 00 11  E1 00 07 10 10 13 1A 08 08 05 0A 05 13 10 30 25 00
   39  01  00  00  00 00 05  C1 13 2E 0E 26
   39  01  00  00  00 00 02  C7 E8
   39  01  00  00  00 00 02  DF 23
   39  01  00  00  00 00 02  B0 01
   39  01  00  00  00 00 03  B9 08 02
   39  01  00  00  00 00 02  B4 02
   39  01  00  00  00 00 02  3A 70
   39  01  00  00  00 00 02  C2 11
   39  01  00  00  00 00 04  BD 00 42 00
   39  01  00  00  00 00 02  EB 24
   15  01  00  00  00 00 02  36 02
   //05  01  00  00  00 00 02  21 00
   05  01  00  00  78 00 02  11 00
   05  01  00  00  0a 00 02  29 00];
		qcom,mdss-dsi-off-command = [05 01 00 00 32 00 02 28 00
					05 01 00 00 78 00 02 10 00];
		qcom,mdss-dsi-on-command-state = "dsi_lp_mode";
		qcom,mdss-dsi-off-command-state = "dsi_lp_mode";
		qcom,mdss-dsi-h-sync-pulse = <1>;
		qcom,mdss-dsi-traffic-mode = "non_burst_sync_plus";
		qcom,mdss-dsi-lane-map = "lane_map_3012";
		qcom,mdss-dsi-bllp-eof-power-mode;
		qcom,mdss-dsi-bllp-power-mode;
		qcom,mdss-dsi-lane-0-state;
		qcom,mdss-dsi-lane-1-state;
		qcom,mdss-dsi-panel-timings = [80 1D 13  00 42 46 18 20 20 03 04 00]; // 419.69MHZ   frame=60hz
		qcom,mdss-dsi-t-clk-post = <0x04>;
		qcom,mdss-dsi-t-clk-pre = <0x1b>;
		qcom,mdss-dsi-bl-min-level = <1>;
		qcom,mdss-dsi-bl-max-level = <255>;
		qcom,mdss-dsi-dma-trigger = "trigger_sw";
		qcom,mdss-dsi-mdp-trigger = "none";
		qcom,mdss-dsi-bl-pmic-control-type = "bl_ctrl_wled";
		qcom,mdss-dsi-reset-sequence = <1 20>, <0 2>, <1 20>;//lijiangshuo add 20131128
	};
};
